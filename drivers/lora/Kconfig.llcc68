## drivers/lora/Kconfig.llcc68
```kconfig
config LORA_LLCC68
	bool "Semtech LLCC68 driver"
	default y
	depends on DT_HAS_SEMTECH_LLCC68_ENABLED || DT_HAS_SEMTECH_LLCC68_ENABLED
	select HAS_SEMTECH_SX126X
	depends on SPI
	help
	  Enable LoRa driver for Semtech LLCC68.
```

## dts/bindings/lora/semtech,llcc68.yaml
```yaml
# Copyright (c) 2020 Andreas Sandberg
# SPDX-License-Identifier: Apache-2.0

description: Semtech LLCC68 LoRa Modem

compatible: "semtech,llcc68"

include: semtech,sx126x-base.yaml

properties:
  reset-gpios:
    required: true
  busy-gpios:
    required: true
  dio1-gpios:
    required: true
```
